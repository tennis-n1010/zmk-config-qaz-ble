#include "layouts/NUMPAD.dtsi"
#include "layouts/MACROPAD.dtsi"
#include "layouts/position_map.dtsi"

&qaz_num_ble_numpad_layout {
    transform = <&qaz_num_ble_numpad_transform>;
};

&qaz_num_ble_macropad_layout {
    transform = <&qaz_num_ble_macropad_transform>;
};
