#include <dt-bindings/zmk/matrix_transform.h>
#include "qaz_ble.dtsi"

/ {
    kscan0: kscan_0 {
        compatible      = "zmk,kscan-gpio-charlieplex";
        interrupt-gpios = <&xiao_d 7 (GPIO_ACTIVE_HIGH | GPIO_PULL_DOWN) >;
        wakeup-source;

        gpios
          = < &xiao_d 0 GPIO_ACTIVE_HIGH >
          , < &xiao_d 1 GPIO_ACTIVE_HIGH >
          , < &xiao_d 2 GPIO_ACTIVE_HIGH >
          , < &xiao_d 3 GPIO_ACTIVE_HIGH >
          , < &xiao_d 4 GPIO_ACTIVE_HIGH >
          , < &xiao_d 5 GPIO_ACTIVE_HIGH >
          , < &xiao_d 6 GPIO_ACTIVE_HIGH >
          ; // addressable space is 7x7, (minus paired values)
    };
};
&xiao_serial { status = "disabled"; };