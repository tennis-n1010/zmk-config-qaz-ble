## boards/shields/qaz_ble/Kconfig.defconfig
```kconfig
if SHIELD_QAZ_BLE

# Name must be less than 16 characters long!
config ZMK_KEYBOARD_NAME
    default "QAZ BLE"

endif
```

## boards/shields/qaz_ble/Kconfig.shield
```kconfig
# No whitespace after the comma or in your keyboard name!
config SHIELD_QAZ_BLE
    def_bool $(shields_list_contains,qaz_ble)
```

## boards/shields/qaz_num_ble/Kconfig.defconfig
```kconfig
if SHIELD_QAZ_NUM_BLE

# Name must be less than 16 characters long!
config ZMK_KEYBOARD_NAME
    default "QAZ NUM BLE"

endif
```

## boards/shields/qaz_num_ble/Kconfig.shield
```kconfig
# No whitespace after the comma or in your keyboard name!
config SHIELD_QAZ_NUM_BLE
    def_bool $(shields_list_contains,qaz_num_ble)
```
